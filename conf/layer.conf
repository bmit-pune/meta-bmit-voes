## conf/layer.conf
```bitbake
# We have a conf and classes directory, add to BBPATH
BBPATH .= ":${LAYERDIR}"

# We have a packages directory, add to BBFILES
BBFILES += "${LAYERDIR}/recipes-*/*/*.bb \
            ${LAYERDIR}/recipes-*/*/*.bbappend"

BBFILE_COLLECTIONS += "bmit-voes"
BBFILE_PATTERN_bmit-voes := "^${LAYERDIR}/"
BBFILE_PRIORITY_bmit-voes = "4"
```
